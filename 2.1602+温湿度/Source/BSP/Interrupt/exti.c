
/**
  ******************************************************************************
  * @file     BSP.c
  * @author   Phone
  * @version  V1.0
  * @date      2015/01/10
  * @brief   STC51中断配置函数
  ******************************************************************************
  * @attention
  * 雅典娜程序
  * CPJ智能控制
  * @endverbatim
  ******************************************************************************
  * @attention
  * 无
  ******************************************************************************
  */
	
#include <reg51.h>
#include <intrins.h>  
#include "exti.h"

water_date water_data1;

#if 1

/**---------------------------------------------------------------------------------
  * @brief      中断0配置函数
  * @param    		无
 ---------------------------------------------------------------------------------*/
void INT0_CONFIG()
{
// IT0=0;       //低电平触发
   IT0=1;       //下降沿触发
   EX0=1;
   EA=1;
}
/**---------------------------------------------------------------------------------
  * @brief     外部 中断0 处理函数
  * @param    		无
  * @retval     计数值
  ---------------------------------------------------------------------------------*/
void INT0_SERVE()
{
    water_data1.mL_data++;
    if(water_data1.mL_data >= 450)    
    {
        water_data1.mL_data = 0;
        water_data1.L_data ++;
        if(water_data1.L_data >= 1000)
        {
            water_data1.L_data = 0;
            water_data1.M3_data ++ ;
            if(water_data1.M3_data >= 1000)
            {
                water_data1.M3_data = 0;         
            }
        }        
    }		
}

/**---------------------------------------------------------------------------------
  * @brief       外部中断0中断服务程序
  * @param    		无
 ---------------------------------------------------------------------------------*/
void  counter0(void) interrupt 0  using 1
{ 
	//	bit i;
		EX0=0;  
		INT0_SERVE();
		//i = ~i;
		LED1 = ~LED1;
		EX0=1;
}
#endif
	
	
	