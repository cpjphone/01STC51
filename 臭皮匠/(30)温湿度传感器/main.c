/******************************************************************************      
* 【语    言】：C语言
* 【编译环境】:	Keil4  
* 【程序功能】：温湿度传感器1602显示
* 【技术支持】：
* 【晶	  振】：11.0592MHz				
* 【芯    片】：stc89c52rc	
* 【日    期】：2013/8/16
* 【作    者】：王云飞
******************************************************************************/
#include "reg52.h" 
#include "head.h" 

/****************************************************************************/
/*								主函数										*/
/****************************************************************************/
void main()
{
      unsigned char i,n=0x40,m;
      lcd_init(); 
      delay_us(); 
      while(1)
      {
           read_TRH();		//读取数据
           for(i=0;i<=7;i++)			//字符显示
           {
               lcd_dis_pos(i);    //第一行显示
               lcd_wdata(dis1[i]);
               lcd_dis_pos(n+i);    //第二行显示
               lcd_wdata(dis2[i]);
            }
            m=0x08;
            for(i=0;i<=7;i++)    		//湿度显示  
            {
                 lcd_dis_pos(m); 
                 lcd_wdata(str1[i]);
                 m++;
            }
            m=0x48;
            for(i=0;i<=7;i++)      		//温度显示
            {
                 lcd_dis_pos(m); 
                 lcd_wdata(str2[i]);
                 m++;
            }
            delay_ms(1000) ;
      }      
} 
