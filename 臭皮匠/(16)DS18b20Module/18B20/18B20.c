/********************************************************************************************************
//程序功能：DS18B20读取温度
********************************************************************************************************/
#include <reg52.h>
#include <intrins.h>				 
#include <18b20Drive.h>

uchar code DS18B20_lab[]={0x3f,0x06,0x5b,0x4f,0x66,0x6d,0x7d,0x07,0x7f,0x6f,0x77,0x7c,0x39,0x5e,0x79,0x71,0x80};
uchar disp_DS18B20_buffer[4];
/********************************************************************************************************
延迟函数，x=1大约延迟1ms
********************************************************************************************************/
void delay(uint x)
{
	uint i,j;
	for(i=0;i<x;i++)
		for(j=0;j<120;j++);
}
/********************************************************************************************************
延迟函数，x=1大约延迟8us
********************************************************************************************************/
void delay_us(uint x)
{
	while(x--);
}

/***********************************************************************/
//显示函数
/***********************************************************************/
void display()
{
	uchar i,temp;
	temp=0xfe;
 	for(i=0;i<4;i++)
	{
		if(i==1)
		{
			P1=DS18B20_lab[disp_DS18B20_buffer[i]]+0x80;
		}
		else
			P1=DS18B20_lab[disp_DS18B20_buffer[i]];
		P0=temp;			
		delay(2);
		P0=0xff;
		temp=(temp<<1)|0x01;		
	}	
}


/********************************************************************************************************
主函数	把温度显示在数码管上
********************************************************************************************************/
void main()
{
	uint temp,i;
	while(1)
	{	
		temp=DS18B20_readtemperature();
		disp_DS18B20_buffer[2]=temp%10;
		disp_DS18B20_buffer[1]=temp%100/10;
		disp_DS18B20_buffer[0]=temp/100;
	
			display();
		
				
	}
}