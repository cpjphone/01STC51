/******************************************************************************      
* 【语    言】：C语言
* 【编译环境】：Keil4  
* 【程序功能】：通过串口助手向单片机发送数据，然后通过第一位数码管显示，注意：只能发送00~09十个数字。
* 【技术支持】：单片机串口通信; 工作方式1; 波特率为9600bps;				
* 【晶    振】: 12MHz外部晶振		
* 【芯    片】: stc89C52rc  
* 【日    期】: 2013/7/17
* 【作    者】: 刘亚飞	
******************************************************************************/
#include<reg52.h>	              //定义头文件
#include<intrins.h>

#define uchar unsigned char	  //宏定义
#define uint  unsigned int

uchar code tab[] = {0x3F,0x06,0x5B,0x4F,0x66,0x6D,0x7D,0x07,0x7F,0x6F,0x00};
uchar disp_buffer[8] = {10,10,10,10,10,10,10,10};
uchar buffer;
/*************************************************/
//延时函数：功能是带有入口参数的延时函数，单位1毫秒
/*************************************************/
void delayms(int m)
{
	int i,j;
	for(i=0;i<m;i++)
	{
		for(j=0;j<123;j++)
		{}
	}
}

/******************************************************************************
 * 函数名:	数码管显示
 * 函数功能:用扫描的方式实现八位数码管的显示 
 *
 * 输入:  无
 * 输出:  无
 * 返回值:无
 *
 * 修改历史:
 * --------------------
 *.jan., Written By:
 * --------------------
 ******************************************************************************/
void display()
{
	uchar i,temp;
	temp = 0xfe;
	for(i=0; i<8; i++)
	{
	 	P2 = temp;
		P0 = tab[disp_buffer[i]];
		delayms(2);
		P0 = 0x00;
		temp = _cror_(temp,1);
	}
}

/******************************************************************************
 * 函数名: 接收数据
 * 函数功能: 单片机接收PC机通过串口发送的数据
 *
 * 输入: 无
 * 输出: 无
 * 返回值:无
 *
 * 修改历史:
 * --------------------
 *.jan., Written By:
 * --------------------
 ******************************************************************************/
void receive()
{
	if(RI == 1)		  //当接收完一帧数据后RI被硬件置1
		{
			RI = 0;	  //通过软件把RI置0，以便再次接收数据
			buffer = SBUF;	//读取SBUF中接收到的数据
		}				
}
/**************************************************/
//主函数
/**************************************************/
void main()
{
	SCON = 0x70;	//选择方式1，允许接收
	PCON = 0x80;	//SMOD=1,波特率加倍
	TMOD = 0x20;	//定时器1工作在方式2
	TH1 = 0xFA;
	TL1 = 0xFA;
	TR1 = 1;		 //打开定时器1
	while(1)
	{
		receive();
		disp_buffer[0] = buffer;
		display();	
	}
}