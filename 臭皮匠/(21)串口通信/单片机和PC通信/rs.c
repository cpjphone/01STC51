/******************************************************************************      
* 【语    言】：C语言
* 【编译环境】：Keil4  
* 【程序功能】：单片机接收PC机1字节的数据，然后在发给PC机
* 【技术支持】：串口通信; 工作方式1; 波特率2400bps; 
				单片机工作在掉电模式，通过外部中断唤醒之后正常工作。				
* 【晶    振】: 11.0592MHZ外部晶振		
* 【芯    片】: stc89c52rc  
* 【日    期】: 2013/7/17
* 【作    者】: 刘亚飞	
******************************************************************************/
#include<reg52.h>	              //定义头文件

#define uchar unsigned char	  //宏定义
#define uint  unsigned int

uchar temp;

/**************************************************/
//主函数
/**************************************************/
void main()
{
	IE = 0x81;		 //打开外部中断0
	IT0 = 1;		 //外部中断0工作在低电平触发方式
	PCON = 0x0F;	 //单片机进入掉电休眠模式
	SCON = 0x70;	 //工作方式1; 允许接收
	TMOD = 0x20;	 //定时器1工作在方式2
	TH1 = 0xF4;
	TL1 = 0xF4;
	TR1 = 1;		//打开定时器1

	while(1)
	{
		while(RI == 0);	 //等待接收数据完毕
		RI = 0;			 //软件将RI清零，以便下次接收数据
		temp = SBUF;	 //读取SBUF中的数据
		SBUF = temp;	//将数据放入发送缓冲区
		while(TI == 0);	//等待数据发送完毕
		TI = 0;			//软件将TI清零
	}
}

/**************************************************/
//外部中断0，用于唤醒单片机
/**************************************************/
void EX_INT0() interrupt 0
{
	PCON = 0x00;
}