#include<reg51.h>								//定义头文件
#include<intrins.h>
#define uchar unsigned char						//宏定义
#define uint unsigned int
uchar disp_buffer[8];
uchar code tab[88]={
0x00,0x00,0x00,0x00,0x00,0x00,0x00,0x00,
0x00,0x3C,0x66,0x42,0x42,0x42,0x66,0x3C,/*"0",0*/
0x00,0x00,0x04,0x04,0x7E,0x00,0x00,0x00,/*"1",1*/
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0x00,0x2C,0x52,0x52,0x52,0x52,0x32,0x3C/*"9",9*/
};
/***********************************************************************/
//延时函数：功能带有入口参数的延时函数，时间单位1毫秒
/***********************************************************************/
void delayms(int m)
{
	int i,j;
	for(i=0;i<m;i++)
	{
		for(j=0;j<123;j++)
		{}
	}
}

void display()
{
	uchar i,temp;
	temp = 0xfe;
	for(i=0;i<8;i++)
	{
		P2 = temp;
		P0 = disp_buffer[i];
		delayms(2);
		P0 = 0x00;
		temp = _crol_(temp,1);	
	}
}
/***********************************************************************/
//
/***********************************************************************/
void main()
{
	uchar i,j=0;
	uint con=0;
	while(1)
	{
		for(i=0;i<8;i++)
		{
			disp_buffer[i] = tab[i+j];
		}
		display();
		con++;
		if(con>6)
		{
			con=0;
			j++;
			if(j>80)
				j=0;
		}	
	}
}

