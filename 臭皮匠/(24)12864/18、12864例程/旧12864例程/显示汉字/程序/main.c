#include<reg52.h>
#include"lcd12864.h"

//---声明一个全局变量---//
void Delay10ms(unsigned int c);

/*******************************************************************************
* 函 数 名         : main
* 函数功能		   : 主函数
* 输    入         : 无
* 输    出         : 无
*******************************************************************************/

void main(void)
{
	uchar i;
	LCD12864_Init();        //初始化
	LCD12864_ClearScreen();	//清屏

	//--由于这个函数显示方向正好相反--//
	LCD12864_Write16CnCHAR(0, 0, "司公限有技科中普");

	while (1)
	{
		for (i=0; i<128; i++)
		{			
			LCD12864_Write16CnCHAR(i, 3, "司公限有技科中普");
			Delay10ms(10);
		}
	
	}
}

/*******************************************************************************
* 函 数 名         : Delay10ms
* 函数功能		   : 延时函数，延时10ms
* 输    入         : 无
* 输    出         : 无
*******************************************************************************/

void Delay10ms(unsigned int c)   //误差 0us
{
    unsigned char a, b;
    for (;c>0;c--)
        for (b=38;b>0;b--)
            for (a=130;a>0;a--);
}
