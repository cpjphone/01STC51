/*********************************************************************************      
* 【语    言】：C语言
* 【编译环境】：Keil4  
* 【程序功能】：双595驱动数码管
* 【技术支持】：定时器中断方式0 、595				
* 【晶    振】: 12MHz外部晶振		
* 【芯    片】: STC89C52RC 
* 【日    期】: 2013/7/28
* 【作    者】: Phone
* 【编程理念】: 死东西活用，活东西套用。
*********************************************************************************/

#include<reg52.h>                                
#include<intrins.h>					  //定义头文件

#define uchar unsigned char                     
#define uint unsigned int			  //宏定义
#define  NOP() _nop_()  			  // 定义空指令 

sbit MOSIO =P3^4;  					  //串行数据线
sbit R_CLK =P3^5;  					  //数据并行输出控制
sbit S_CLK =P3^6;  					  //串行时钟线

uchar sec,min,hour,count ;			  //定义时分秒 时间变量

/************************************************************************/
//（活东西）显示缓存
/************************************************************************/
uchar disp_buffer[8]={0};

/************************************************************************/
//（死东西）可调用数组
/************************************************************************/
uchar code tab[] = {
0x3F,0x06,0x5B,0x4F,0x66,0x6D,0x7D,0x07,0x7F,0x6F,0x40,0x80,0x00};

/************************************************************************/
//595 驱动
/************************************************************************/
void HC595SendData(unsigned int SendVal)
{  
	unsigned char i;
	
	
	for(i=0;i<8;i++) 
	{
		if((SendVal<<i)&0x80)
			MOSIO=1;  					//set dataline high  0X80  最高位与SendVal左移的最高位 进行逻辑运算
		else MOSIO=0;				    // 如果为真 MOSIO = 1  
		
		S_CLK=0;  
		NOP();	 						//短暂延时产生一定宽度的脉冲信号
		NOP();	 						//短暂延时、上升沿读取数据
		S_CLK=1;
	
	}
		
}

/************************************************************************/
//595 驱动 开关
/************************************************************************/
void HC595out()
{
		R_CLK=0;						//set dataline low
		NOP();  						//短暂延时
		NOP(); 							//短暂延时、上升沿读取数据
		R_CLK=1; 
}

/************************************************************************/
//延时函数
/************************************************************************/
void delayms(uint ms)
{
	uint i,j;  
	for(i=0;i<ms;i++)
		for(j=0;j<121;j++);
}

/************************************************************************/
//数码管显示函数
/************************************************************************/
void display()
{
	uchar i,temp;
	temp = 0xfe;
	for(i=0;i<8;i++)
	{
		
		HC595SendData(tab[disp_buffer[i]]);
		HC595SendData(temp);
		HC595out();
		temp = _crol_(temp,1);				  //因为移位与放段同时，故i 是几，就送到哪位去。
	}			  
}
/************************************************************************/
//主函数
/************************************************************************/
void main()
{
	uint HC595SendVal;
	char i;
	EA = 1;
	ET0 =1;
	TMOD = 0x01;
	TH0 = (65536-50000)/256;//0x3c;
	TL0 = (65536-50000)%256;//0xb0;
	TR0 = 1;
	while(1)
	{	
			
			disp_buffer[2] = 10;
			disp_buffer[5] = 11;
			disp_buffer[1] = hour%10;
			disp_buffer[0] = hour/10;
			disp_buffer[4] = min%10;
			disp_buffer[3] = min/10;
			disp_buffer[7] = sec%10;
			disp_buffer[6] = sec/10;		
			for(i = 0;i < 5;i--)
			display();





	}
}
/************************************************************************/
//中断服务函数：用于计数时、分、秒
/************************************************************************/
void timer0() interrupt 1
{
	TH0 = (65536-50000)/256;//0x3c;
	TL0 = (65536-50000)%256;//0xb0;
	count++;
	if(count > 19)
	{
		count = 0;		
			sec++;
		if(sec > 59)
		{
			sec = 0;
			min++;
			if(min > 59)
			{
				min = 0;
				hour++;
				if(hour > 23)
					hour = 0;
			}
		}	
	}	
}