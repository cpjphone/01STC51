/*********************************************************************************      
* 【语    言】：C语言
* 【编译环境】：Keil4  
* 【程序功能】：8*8点阵流动显示时钟
* 【技术支持】：定时器中断方式0 、595				
* 【晶    振】: 12MHz外部晶振		
* 【芯    片】: STC89C52RC 
* 【日    期】: 2013/6/12
* 【作    者】: Phone
*********************************************************************************/

#include<reg52.h>                                //定义头文件
#include<intrins.h>
#define uchar unsigned char                     
#define uint unsigned int						 //宏定义

uchar count,flag_t;								 //定义计数变量与标志位
char sec,min = 57,hour = 12;					 //定义时分秒 时间变量

/************************************************************************/
//（活东西）显示函数缓存空间
/************************************************************************/
uchar disp_buffer[8];

/************************************************************************/
//（死东西）显示函数缓存空间
/************************************************************************/
uchar code xin[6][8]={
{0x00,0x00,0x00,0x20,0x10,0x20,0x00,0x00},
{0x00,0x00,0x10,0x20,0x10,0x20,0x10,0x00},
{0x00,0x00,0x18,0x20,0x10,0x20,0x18,0x00},
{0x00,0x00,0x18,0x24,0x10,0x24,0x18,0x00},
{0x00,0x00,0x18,0x24,0x12,0x24,0x18,0x00},
{0x00,0x00,0x18,0x3C,0x1E,0x3C,0x18,0x00},		 /***"心形"***/	
};

/************************************************************************/
//（活东西）可变缓存空间，用于存放数据变换的时钟数据
/************************************************************************/
uchar disp_shizhong2[66];

/************************************************************************/
//（死东西）可调用数组
/************************************************************************/
uchar code tab[12][8]={
{0x00,0x00,0x3e,0x41,0x41,0x41,0x3e,0x00}, //0

{0x00,0x00,0x00,0x00,0x21,0x7f,0x01,0x00}, //1
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{0x00,0x00,0x00,0x66,0x66,0x00,0x00,0x00}, //:
};

/************************************************************************/
//声明595驱动函数
/************************************************************************/
void HC595SendData(unsigned char SendVal);
  
/************************************************************************/
//延时函数：功能带有入口参数的延时函数，时间单位1毫秒
/************************************************************************/
void delayms(int m)
{
    int i,j;
    for(i=0;i<m;i++)
    {
        for(j=0;j<123;j++)
        {}
    }
}

/************************************************************************/
//点阵显示函数：595数据到行（实数）、P2口送扫描数据
/************************************************************************/
void display()
{
    uchar i,temp,HC595SendVal;
    temp = 0xfe;
    for(i=0;i<8;i++)
    {
        P2 = temp;
        HC595SendVal = disp_buffer[i];
		HC595SendData(HC595SendVal);
        delayms(2);
        HC595SendVal = 0;
		HC595SendData(HC595SendVal);
        temp = _crol_(temp,1);  
    }
}


/************************************************************************/
//主函数
/************************************************************************/
void main()
{
    uchar k,m,n,i,j,con=0;
	EA = 1;					//开 总中断
	ET0 =1;					//开 计算器0 中断
	TMOD = 0x01;			//设置 计算器工作模式为 方式1、16位计数
	TH0 = (65536-50000)/256;//0x3c（高位装初值）;
	TL0 = (65536-50000)%256;//0xb0（低位装初值）;
	TR0 = 1;				//启动 定时器0中断						   
    while(1)
    {		   			   	
				for(k=0; k<8;k++)
				{
					disp_shizhong2[k] = tab[hour/10][k];
					disp_shizhong2[8+k] = tab[hour%10][k];
					disp_shizhong2[16+k] = tab[10][k];
					disp_shizhong2[24+k] = tab[min/10][k];
					disp_shizhong2[32+k] = tab[min%10][k];
					disp_shizhong2[40+k] = tab[10][k];
					disp_shizhong2[48+k] = tab[sec/10][k];
					disp_shizhong2[56+k] = tab[sec%10][k];									
				}								
							//可变时钟数据存储到缓存空间 disp_shizhong2[66]
																
				
				if(con>7)   //每一屏显示时间
					{
						con=0;
						n++;
						if(n>64)
							n=0;					
					}
						    //显示64屏
				if(n<63)
					{		
						for(m=0;m<8;m++) 
						{
							disp_buffer[m] = disp_shizhong2[m+n];							
						}
						display();
						
					}
						   //时钟显示函数
									 
				if((n>63)&(con<2))
					{
						 for(i = 0;i < 6;i++)
						 {
							for(m=0;m<8;m++) 
							{
								disp_buffer[m] = xin[i][m];
							}
							for(j = 0;j < 15; j++)
							display();
						}						
					}
						   //心形显示函数
				con++;
						        																																
	}
											     
}

/************************************************************************/
//中断服务函数：用于计数时、分、秒
/************************************************************************/
void timer0() interrupt 1
{
	TH0 = (65536-50000)/256;//0x3c;
	TL0 = (65536-50000)%256;//0xb0;
	count++;
	if(count > 19)
	{
		count = 0;
		if(flag_t == 0)
			sec++;
		if(sec > 59)
		{
			sec = 0;
			min++;
			if(min > 59)
			{
				min = 0;
				hour++;
				if(hour > 23)
					hour = 0;
			}
		}	
	}	
}
