#include<reg52.h>
#include <I2C.H>
#include "LCD1602_Drive.h"
#include "PCF8591Drive.h"
unsigned char i;
sbit LED = P1^0;
unsigned int LedOut[5],LedOut2[5];
uchar code LCD1602_tab1[14]="0123456789.D[]";	 //字符串	

/*************************************************************************************
延时函数							   	
*************************************************************************************/
void delay(uint x)
{
	uint i,j;
	for(i=0;i<x;i++)
		for(j=0;j<120;j++);
}
/*************************************************************************************
主函数							   	
*************************************************************************************/
main()
{  
	LCD1602_init();	
	while(1)
	{
		/*****AD-DA 只需调用头文件和此函数名 即可***********/
		PCF8591Return();
								
		/********以下将AD的值送到LED数码管显示*************/

		LedOut[0] = D[0]%10000/1000;
		LedOut[1] = D[0]%1000/100;
		LedOut[2] = 10;
		LedOut[3] = D[0]%100/10;
		LedOut[4] = D[0]%10;
		
		LedOut2[0] = D[1]%10000/1000;
		LedOut2[1] = D[1]%1000/100;
		LedOut2[2] = 10;
		LedOut2[3] = D[1]%100/10;
		LedOut2[4] = D[1]%10;  
		
		LCD1602_write_com(0x80);	   				     //设置指针地址为第二行第一个位置
		LCD1602_write_word("D[0]:");
		  
		LCD1602_write_com(0x80+0x05);		   			 //设置指针地址为第一行第1个位置
		for(i=0;i<5;i++)
		{
			LCD1602_write_data(LCD1602_tab1[LedOut[i]]);
		}
		LCD1602_write_com(0x80+0x40);	   			  	//设置指针地址为第二行第一个位置
		LCD1602_write_word("D[1]:");

		LCD1602_write_com(0x80+0x45);	   			 	//设置指针地址为第二行第一个位置
		for(i=0;i<5;i++)
		{
			LCD1602_write_data(LCD1602_tab1[LedOut2[i]]);
		}
 }  
}
