#include <reg52.h>
#include <intrins.h>				 
#include <18b20Drive.h>
#include <LCD1602_Drive.h>				   //头文件


uchar code LCD1602_tab1[11]="0123456789.";	 //字符串
uchar tab[4];    //时高位,时低位,：,分高位,分低位,：,秒高位,秒低位

/*************************************************************************************
延时函数							   	
*************************************************************************************/
void delay(uint x)
{
	uint i,j;
	for(i=0;i<x;i++)
		for(j=0;j<120;j++);
}
/*************************************************************************************
主函数
*************************************************************************************/
void main()
{
	uchar i;
	uint temp;
	LCD1602_init();
	DS18B20_init();
	while(1)
	{
		temp=DS18B20_readtemperature();
		tab[3]=temp%10;
		tab[2]=10;
		tab[1]=temp%100/10;
		tab[0]=temp/100;

		LCD1602_write_com(0x80+0x04);		   			//设置指针地址为第一行第五个位置
		for(i=0;i<4;i++)
		{
			LCD1602_write_data(LCD1602_tab1[tab[i]]);
		}
		LCD1602_write_com(0x80+0x08);	   				//设置指针地址为第二行第一个位置
		LCD1602_write_word("C");
	}
}