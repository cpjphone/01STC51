/****************************************************************************/
#include<reg52.h>	              //定义头文件
#define uchar unsigned char	  //宏定义
#define uint  unsigned int

sbit RS = P2^6;                                                        
sbit RW = P2^5;                                                        
sbit EN = P2^7;
/*************************************************/
//延时函数：功能是带有入口参数的延时函数，单位约1毫秒
/*************************************************/
void delayms(int m)
{
	int i,j;
	for(i=0;i<m;i++)
	{
		for(j=0;j<123;j++)
		{}
	}
}

/**************************************************/
//写指令
/**************************************************/
void write_com(uchar com)
{
	RW = 0;			//RW为低电平时，1062处于写状态
	RS = 0;			//RS为低电平时，写命令
	delayms(1);		//稍作延时
	P0 = com;		//把命令放在数据传送端
	EN = 1;			//使1602处于有效状态
	delayms(1);		//稍作延时
	EN =0;			//使EN处于下降沿
}

/**************************************************/
//写数据
/**************************************************/
void write_data(uchar dat)
{
	RW = 0;			//RW为低电平时，1062处于写状态
	RS = 1;			//RS为高电平时，写数据
	delayms(1);		//稍作延时
	P0 = dat;		//把数据放在数据传送端
	EN = 1;			//使1602处于有效状态
	delayms(1);		//稍作延时
	EN =0;			//使EN处于下降沿	
}

/**************************************************/
//液晶字符显示的位置
/**************************************************/
void gotoXY(uchar x,uchar y)   //x为显示指针的位置，即为各行的第几个位置；Y选行。
{
	if(y == 0)
	write_com(x + 0x80);
	if(y == 1)
	write_com(x + 0x40 + 0x80);
}
/**************************************************/
//初始化
/**************************************************/
void init()
{
	EN = 0;
	write_com(0x38);	//显示模式设定
	write_com(0x0f);    //开关显示、光标有无设置、光标闪烁设置
	write_com(0x06);    //写一个字符后指针加一
	write_com(0x01);	//清屏指令
}
/**************************************************/
//主函数
/**************************************************/
void main()
{
	init();
	gotoXY(0,0);
	write_data('8');
	while(1)
	{

	}
}
