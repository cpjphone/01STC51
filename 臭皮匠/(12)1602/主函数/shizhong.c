/*************************************************************************************
//LCD1602时钟测试程序
*************************************************************************************/
#include <reg52.h>				           //头文件
#include <LCD1602_Drive.h>				   //头文件

uchar sec,min,hou=12;			          //定义全局变量
uchar tab[8]={0,0,10,0,0,10,0,0};    //时高位,时低位,：,分高位,分低位,：,秒高位,秒低位
uchar code LCD1602_tab1[11]="0123456789:";	 //字符串

uchar code table[8]={0x00,0x0C,0x1E,0x1E,0x1E,0x1E,0x1E,0x1E};
uchar code table1[8]={0x00,0x00,0x01,0x01,0x05,0x05,0x15,0x15};

uchar count;	
/*************************************************************************************
延时函数							   	
*************************************************************************************/
void delay(uint x)
{
	uint i,j;
	for(i=0;i<x;i++)
		for(j=0;j<120;j++);
}

/*************************************************************************************
初始化
*************************************************************************************/
void interrupt_init()
{
	
	TMOD=0x01;							//定时器0，方式1
	TH0=(65536-50000)/256;
	TL0=(65536-50000)%256;
	EA=1;								//开总中断
	ET0=1;								//允许T0中断
	TR0=1;								//开定时器
}
/*************************************************************************************
时分秒数据处理
*************************************************************************************/
void deal()
{
	tab[6]=sec/10;
	tab[7]=sec%10;
	tab[3]=min/10;
	tab[4]=min%10;
	tab[0]=hou/10;
	tab[1]=hou%10;
}

/*************************************************************************************
主函数
*************************************************************************************/
void main()
{
	uchar i;
	interrupt_init();
	LCD1602_init();
	while(1)
	{
		deal();
		LCD1602_write_com(0x80+0x04);		   			//设置指针地址为第一行第五个位置
		for(i=0;i<8;i++)
		{
			LCD1602_write_data(0x30+tab[i]);
		}
		LCD1602_write_com(0x80+0x43);	   				//设置指针地址为第二行第一个位置
		LCD1602_write_word("I am China");
	}
}
/*************************************************************************************
定时器0中断服务程序，每50ms中断一次
*************************************************************************************/
void timer0() interrupt 1 using 1
{
	TH0=(65536-50000)/256;
	TL0=(65536-50000)%256;
	count++;
	if(count>=20)
	{
		count=0;
		sec++;
		if(sec>59)
		{
			sec=0;
			min++;
			if(min>59)
			{
				min=0;
				hou++;
				if(hou>23)
				{
					hou=0;
				}
			}
		}
	}
}