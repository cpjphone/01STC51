/********************************************************************************************************
//程序功能：DS18B20读取温度
********************************************************************************************************/
#include <reg52.h>
#include <intrins.h>				 
#define uchar unsigned char
#define uint unsigned int
sbit dq=P1^7;
uchar code lab[]={0x3f,0x06,0x5b,0x4f,0x66,0x6d,0x7d,0x07,0x7f,0x6f,0x77,0x7c,0x39,0x5e,0x79,0x71,0x80};
uchar flag;
uchar disp_buffer[4];
/********************************************************************************************************
延迟函数，x=1大约延迟1ms
********************************************************************************************************/
void delay(uint x)
{
	uint i,j;
	for(i=0;i<x;i++)
		for(j=0;j<120;j++);
}
/********************************************************************************************************
延迟函数，x=1大约延迟8us
********************************************************************************************************/
void delay_us(uint x)
{
	while(x--);
}
/********************************************************************************************************
初始化函数
********************************************************************************************************/
void init()
{
	dq=1;
	delay_us(2);				//拉高一段时间
	dq=0;
	delay_us(70);				//延时480us以上
	dq=1;
	while(dq);					//等待存在脉冲
	delay_us(15);				//存在脉冲存活时间
	dq=1;						//拉高总线
}
/********************************************************************************************************
写指令函数，每次写入一个字节dat
********************************************************************************************************/
void write(uchar dat)
{
	uchar i;
	for(i=0;i<8;i++)
	{
		dq=0;
		dq=dat&0x01;
		delay_us(4);
		dq=1;
		dat>>=1;
	}
}
/********************************************************************************************************
读函数，每次返回16位的温度值
********************************************************************************************************/
uint read()
{
	uchar i;
	uint dat;
	for(i=0;i<16;i++)
	{
		dq=0;
		dq = 1;
		if(dq)
		{
			
			dat=(dat>>1)|0x8000;
		}
		else
			dat>>=1;//dat = dat >> 1;
		dq=1;
		delay_us(4);
	} 
	return(dat);
}
/********************************************************************************************************
读取温度函数，返回温度的绝对值，并标注flag，flag=1表示负，flag=0表示正
********************************************************************************************************/
uint readtemperature()
{
	uint temp;
	float m;
	init();
	write(0xcc);			//跳过读ROM
	write(0x44);			//启动温度转换
	init();
	write(0xcc);
	write(0xbe);			//读取温度寄存器
	temp=read();
	if(temp>0x0fff)
	{
		flag=1;
		temp=(~temp)+1;
	}
	else
	{
		flag=0;
	}
	m=temp*0.0625;
	temp=m*10+0.5;			//放大10倍四舍五入输出
	return(temp);
}

/***********************************************************************/
//显示函数
/***********************************************************************/
void display()
{
	uchar i,temp;
	temp=0xfe;
 	for(i=0;i<4;i++)
	{
		if(i==1)
		{
			P0=lab[disp_buffer[i]]+0x80;
		}
		else
			P0=lab[disp_buffer[i]];
		P2=temp;			
		delay(2);
		P2=0xff;
		temp=(temp<<1)|0x01;		
	}	
}
/********************************************************************************************************
主函数	把温度显示在数码管上
********************************************************************************************************/
void main()
{
	uint temp,i;
	while(1)
	{	
		temp=readtemperature();
		disp_buffer[2]=temp%10;
		disp_buffer[1]=temp%100/10;
		disp_buffer[0]=temp/100;
		for(i=0;i<50;i++)
		{
			display();
		}
				
	}
}