/********************************************************************************************
函数名称：	LCD1602.c
描述	：	LCD162底层驱动
输入	：	无
输出	：	无
返回	：	无
注意事项：	无
*********************************************************************************************/
#include "LCD1602.h"


//uchar code table[]={"NRF24L01 Tem Sys"};
//uchar code table1[]={"Rece Tem 000.°C"};
/********************************************************************************************
名称：void LCD1602_check_busy();void LCD1602_write_cmd(uchar cmd);
	  void LCD1602_write_data(uchar dat);void LCD1602_init(); 

功能：LCD1602驱动程序(忙检查;写指令;写数据;初始化) 
*********************************************************************************************/	

/***********************************************************
忙检测
************************************************************/
void LCD1602CheckBusy()
{
    LCD1602_DATA = 0xff;
    LCD1602_RS = 0 ;	
    LCD1602_RW = 1 ;	
    LCD1602_EN = 1 ;	
    while(LCD1602_DATA & 0x80) ;	
    LCD1602_EN = 0 ;			
}

/**********************************************************
写指令    
************************************************************/
void LCD1602WriteCmd(uchar cmd)
{
    LCD1602CheckBusy();	
    LCD1602_RS = 0 ;	
    LCD1602_RW = 0 ;	
    LCD1602_DATA = cmd ;	
    LCD1602_EN = 1 ;
    _nop_();    
    LCD1602_EN = 0 ;
}

/***********************************************************
写数据
*************************************************************/
void LCD1602WriteData(uchar dat)
{
    LCD1602CheckBusy();	
    LCD1602_RS = 1 ;	
    LCD1602_RW = 0 ;	
    LCD1602_DATA = dat ;	
    LCD1602_EN = 1 ;
    _nop_();	
    LCD1602_EN = 0 ;
}

/***********************************************************
1602初始化
************************************************************/
void Init_LCD1602()
{
/****************写入自定义字符***************************/
    //uchar i;
    LCD1602WriteCmd(0x40);//CGRAM起始地址
    //for(i=0;i<48;i++)
    //    LCD1602_write_data(self_table[i]);//写入6个自定义字符
/*********************************************************/

    LCD1602WriteCmd(0x38);  //8位数据，双列显示，5*7字形
    LCD1602WriteCmd(0x0c);  //开显示，关光标，光标不闪烁
    LCD1602WriteCmd(0x01);  //清屏
}

/************************************************************
设置显示坐标
************************************************************/
void LCD1602SetPostion(uchar x , uchar y)
{
	if(!y)
		LCD1602WriteCmd(0x80+x) ;
	else if(y)
		LCD1602WriteCmd(0xc0+x) ;
}

/************************************************************
指定位置写字符
*************************************************************/
//void LCD1602WriteChar(uchar x,uchar y,uchar chardata)
//{
//    LCD1602SetPostion(x,y);
//    LCD1602WriteData(chardata);
//}

/************************************************************
指定位置写字符串
*************************************************************/
void LCD1602WriteString(uchar x,uchar y,uchar *string)
{
    LCD1602SetPostion(x,y) ;
    while((*string) != '\0')
    {	
        LCD1602WriteData(*string) ;
        string++ ;
    }
}